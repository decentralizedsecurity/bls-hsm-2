## CMakeLists.txt
```
#
# Copyright (c) 2021 Nordic Semiconductor ASA
#
# SPDX-License-Identifier: Apache-2.0
#

cmake_minimum_required(VERSION 3.20)

find_package(Zephyr REQUIRED HINTS $ENV{ZEPHYR_BASE})

get_target_property(TFM_BINARY_DIR tfm TFM_BINARY_DIR)
configure_file(
  ${CMAKE_CURRENT_LIST_DIR}/../secure_partition/tfm_manifest_list.yaml.in
  ${CMAKE_CURRENT_BINARY_DIR}/secure_partition/tfm_manifest_list.yaml
)

set_property(TARGET zephyr_property_target
  APPEND PROPERTY TFM_CMAKE_OPTIONS
  -DTFM_EXTRA_MANIFEST_LIST_FILES=${CMAKE_CURRENT_BINARY_DIR}/secure_partition/tfm_manifest_list.yaml
  -DTFM_EXTRA_PARTITION_PATHS=${CMAKE_CURRENT_LIST_DIR}/../secure_partition
)

project(mycli)
add_definitions(-DNRF -DTFM)

target_sources(app PRIVATE
  src/main.c
  src/secure_partition_interface.c
  ../lib/bls_hsm_ns.c
  ../lib/common.c
)

zephyr_library_include_directories(
  ../lib/
)

#add_library(testlib STATIC IMPORTED)
#target_link_libraries(app PUBLIC ${APPLICATION_SOURCE_DIR}/../lib/libblst.a)

#add_library(mylib_lib STATIC IMPORTED GLOBAL)
#add_dependencies(
#  mylib_lib
#  mylib_project
#  )
#set_target_properties(mylib_lib PROPERTIES IMPORTED_LOCATION             ${APPLICATION_SOURCE_DIR}/../lib/libblst.a)
#set_target_properties(mylib_lib PROPERTIES INTERFACE_INCLUDE_DIRECTORIES ${APPLICATION_SOURCE_DIR}/../lib)

#target_link_libraries(app PUBLIC mylib_lib)

target_include_directories(app PRIVATE
  $<TARGET_PROPERTY:tfm,TFM_BINARY_DIR>/install/interface/include
)

target_compile_definitions(app
    PRIVATE TFM_PARTITION_DUMMY_PARTITION
)

# To see type of fatal error in the log 
set_property(
TARGET zephyr_property_target
APPEND PROPERTY TFM_CMAKE_OPTIONS

# Use -O0. So GDB reports correct line numbers.
-DCMAKE_BUILD_TYPE=Debug

# Halt instead of rebooting on internal TF-M faults.
-DTFM_HALT_ON_CORE_PANIC=ON

# NB: Probably not enough MPU regions on nrf53 in Isolation level 2
-DNULL_POINTER_EXCEPTION_DETECTION=ON

# Add a debug function that logs the memory protection config, and
# then invoke it from the SPE with log_memory_protection() to see
# the memory protection configuration.
-DLOG_MEMORY_PROTECTION=ON

# WDT will force tests to continue for certain types of TF-M
# tests. This can be inconvenient when debugging. But the WDT can
# also be a necessary part of the test execution.
# -DWATCHDOG_AVAILABLE=0
)
```

## prj.conf
```kconfig
#
# Copyright (c) 2021 Nordic Semiconductor ASA
#
# SPDX-License-Identifier: Apache-2.0
#

CONFIG_BUILD_WITH_TFM=y
CONFIG_TFM_PROFILE_TYPE_NOT_SET=y

CONFIG_PRINTK=y
CONFIG_SHELL=y
CONFIG_LOG=y
CONFIG_INIT_STACKS=y
CONFIG_THREAD_STACK_INFO=y
CONFIG_KERNEL_SHELL=y
CONFIG_THREAD_MONITOR=y
#CONFIG_BOOT_BANNER=n
CONFIG_THREAD_NAME=y
CONFIG_DEVICE_SHELL=y
CONFIG_POSIX_CLOCK=y
CONFIG_DATE_SHELL=y
CONFIG_HEAP_MEM_POOL_SIZE=49152
#CONFIG_THREAD_ANALYZER=y
#CONFIG_THREAD_ANALYZER_USE_PRINTK=y
#CONFIG_THREAD_ANALYZER_AUTO=y
#CONFIG_THREAD_ANALYZER_AUTO_INTERVAL=5
CONFIG_SHELL_STACK_SIZE=49152
CONFIG_FW_INFO=y
CONFIG_SHELL_CMD_BUFF_SIZE= 376
CONFIG_NEWLIB_LIBC=y
CONFIG_NEWLIB_LIBC_NANO=n
CONFIG_NEWLIB_LIBC_FLOAT_PRINTF=y
CONFIG_CJSON_LIB=y
CONFIG_NRF_MODEM_LIB=n
CONFIG_NORDIC_SECURITY_BACKEND=y

# For building without enable debug option
#CONFIG_PM_PARTITION_SIZE_TFM=0x50000
# For building with enable debug option
CONFIG_PM_PARTITION_SIZE_TFM=0x60000
#CONFIG_PM_PARTITION_SIZE_TFM_SRAM=0x63000

#CONFIG_MAIN_STACK_SIZE=51200

# This option enables the UART logging backend.
CONFIG_LOG_BACKEND_UART=y
CONFIG_LOG_DEFAULT_LEVEL=4
#CONFIG_LOG_PRINTK=y
CONFIG_DEBUG_OPTIMIZATIONS=y
CONFIG_DEBUG_THREAD_INFO=y
CONFIG_LOG_MODE_IMMEDIATE=y
CONFIG_ASSERT=y
CONFIG_NO_OPTIMIZATIONS=y
CONFIG_THREAD_NAME=y
CONFIG_USE_SEGGER_RTT=y
CONFIG_LOG_BACKEND_RTT=y
CONFIG_LOG_BACKEND_SHOW_COLOR=y
#?CONFIG_TFM_SPM_LOG_LEVEL_INFO=y

CONFIG_RESET_ON_FATAL_ERROR=n

#
CONFIG_TFM_PARTITION_LOG_LEVEL_DEBUG=y
CONFIG_TFM_SPM_LOG_LEVEL_DEBUG=y

# Dump exception info. Must be combined with enabling log output.
CONFIG_TFM_EXCEPTION_INFO_DUMP=y

# Don't use the minimal TF-M configuration as that doesn't support logging
CONFIG_TFM_PROFILE_TYPE_NOT_SET=y
```

## src/main.c
```c
/*
 * Copyright (c) 2021 Nordic Semiconductor ASA.
 *
 * SPDX-License-Identifier: Apache-2.0
 */

#include <zephyr.h>
#include <tfm_veneers.h>
#include <tfm_ns_interface.h>
#include <sys/printk.h>
#include <shell/shell.h>
#include <version.h>
#include <logging/log.h>
#include <stdlib.h>
#include <kernel.h>
#include <stdio.h>
#include <secure_services.h>
#include <pm_config.h>
#include <fw_info.h>
#include <drivers/uart.h>
#include <cJSON.h>
#include <string.h>
#ifdef CONFIG_USB
#include <usb/usb_device.h>
#endif

#include "bls_hsm_ns.h"

char buffer[2048] = "";

static uint32_t GetFreeMemorySize()
{
  uint32_t  i;
  uint32_t  len;
  uint8_t*  ptr;
 
  for(i=1;;i++)
  {
    len = i * 1024;
    ptr = (uint8_t*)malloc(len);
    if(!ptr){
      break;
    }
    free(ptr);
  }
 
  return i;
}

LOG_MODULE_REGISTER(app);

static int cmd_keygen(const struct shell *shell, size_t argc, char **argv)
{
    if(argc == 1){
        keygen("", buffer);
		//printk("Keystore size: %d\n", ret, get_keystore_length()); // MUST BE DELETED
    }else{
        keygen(argv[1], buffer);
    }
    printf(buffer);
    memset(buffer, 0, 2048);
    return 0;
}

static int cmd_signature_message(const struct shell *shell, size_t argc, char **argv, char* buff)
{
    if(signature(argv[1], argv[2], buffer) == 0){
        printf("Signature: \n");
        printf("%s%s\n", "0x", buffer);
    }else{
        printf(buffer);
    }
    memset(buffer, 0, 2048);
	return 0;
}

/*static int cmd_signature_verification(const struct shell *shell, size_t argc, char **argv, char* buff)
{
    verify(argv[1], argv[2], argv[3], buffer);
    printf(buffer);
    memset(buffer, 0, 2048);
	return 0;
}*/

/*static int cmd_get_keys(const struct shell *shell, size_t argc, char **argv, char* buff)
{
    print_keys_Json(buffer);
    printf(buffer);
    memset(buffer, 0, 2048);
	return 0;
}*/

static int cmd_reset(const struct shell *shell, size_t argc, char **argv, char* buff){
    resetc(buffer);
    printf(buffer);
    memset(buffer, 0, 2048);
    return 0;
}

static int cmd_prompt(const struct shell *shell, size_t argc, char **argv){
    ARG_UNUSED(argc);

    if(strcmp(argv[1], "on") == 0){
        shell_prompt_change(shell, "uart:~$ ");
    }else if(strcmp(argv[1], "off") == 0){
        shell_prompt_change(shell, "");
    }else{
        printf("Usage: prompt on/off\n");
    }
    return 0;
}

/*static int cmd_import(const struct shell *shell, size_t argc, char **argv){
    import(argv[1], buffer);
    printf(buffer);
    memset(buffer, 0, 2048);
    return 0;
}*/

SHELL_CMD_ARG_REGISTER(keygen, NULL, "Generates secret key and public key", cmd_keygen, 1, 1);

SHELL_CMD_ARG_REGISTER(signature, NULL, "Signs a message with a specific public key", cmd_signature_message, 3, 0);

//SHELL_CMD_ARG_REGISTER(verify, NULL, "Verifies the signature", cmd_signature_verification, 4, 0);

//SHELL_CMD_ARG_REGISTER(getkeys, NULL, "Returns the identifiers of the keys available to the signer", cmd_get_keys, 1, 0);

SHELL_CMD_ARG_REGISTER(reset, NULL, "Deletes all generated keys", cmd_reset, 1, 0);

SHELL_CMD_ARG_REGISTER(prompt, NULL, "Toggle prompt", cmd_prompt, 2, 0);

//SHELL_CMD_ARG_REGISTER(import, NULL, "Import secret key", cmd_import, 2, 0);

void main(void)
{
	/*uint8_t digest[32];

	for (int key = 0; key < 6; key++) {
		psa_status_t status = dp_secret_digest(key, digest, sizeof(digest));

		if (status != PSA_SUCCESS) {
			printk("Status: %d\n", status);
		} else {
			printk("Digest: ");
			for (int i = 0; i < 32; i++) {
				printk("%02x", digest[i]);
			}
			printk("\n");
		}
	}*/
	printk("===========================>\n");

	int ret = 99;
	ret = keygen("", buffer);
	printk("Generated new pair of keys. Index = %d\n", ret);
	printk("Keystore size: %d\n", get_keystore_length()); // MUST BE DELETED
	memset(buffer, 0, 2048);
	ret = keygen("", buffer);
	printk("Generated new pair of keys. Index = %d\n", ret);
	printk("Keystore size: %d\n", get_keystore_length()); // MUST BE DELETED
	memset(buffer, 0, 2048);

	// get_pk
	char pk[97];
	get_pk(0, pk);
	pk[96] = '\0';
	printk("Generated public key 0:\n%s\n", pk);

	// get_keys
	int num = print_keys_Json(buffer);
	printk("There are %d keys inside keystore\n", num);
    printk("Print keys Json: %s\n", buffer);
    memset(buffer, 0, 2048);

	// Get Free Memory Size
	//ret = GetFreeMemorySize();
	//printk("Free memory size (main.c): %d\n", ret);
	//ret = tfm_get_free_memory_size();
	//printk("Free memory size (from secure partition): %d\n", ret);

	// sign_pk
	char msg[] = "5656565656565656565656565656565656565656565656565656565656565656";
	signature(pk, msg, buffer);	
	printk("Signature:\n%s\n", buffer);
	memset(buffer, 0, 2048);

	// verify_sign
	/*char pk2[] = "0x86a722b1f5c1cb1420ff0766cf5205b023de2e9c69efc65dbf976af2d710c3d12f937cf7104c9cd51bb4c62ff185d07f";
	ret = verify(pk2, msg,
		"0xb912c912616709f6a190b03db1a259ca21f535abe51f88d6c95407a81fd8648b067c5e0548587f6a84f2dea9afd2098812bb1d7fb188f1d04411a04f25042b627c5f8d60dcef6416072cfef40b799b3c89397bcddf69ae62611484bfc6e83689",
		buffer);
	printk("verify: %d\n", ret);
	printk("buffer: %s\n", buffer);*/

	// Another keygen
	printk("Let's do another keygen...\n");
	ret = keygen("", buffer);
	printk("Generated new pair of keys. Index = %d\n", ret);
	printk("Keystore size: %d\n", get_keystore_length()); // MUST BE DELETED
	memset(buffer, 0, 2048);

	// get_keys
	num = print_keys_Json(buffer);
	printk("There are %d keys inside keystore\n", num);
    printk("Print keys Json: %s\n", buffer);
    memset(buffer, 0, 2048);

	// reset
	resetc(buffer);
	printk("%s\n", buffer);
	memset(buffer, 0, 2048);
	printk("Keystore size: %d\n", get_keystore_length()); // MUST BE DELETED

	printk("!!!!!!!!!!!!!!!!!!!!!!!!!!!!\n");
}
```

## src/secure_partition_interface.c
```c
/*
 * Copyright (c) 2021 Nordic Semiconductor ASA.
 *
 * SPDX-License-Identifier: Apache-2.0
 */

#include <tfm_veneers.h>
#include <tfm_ns_interface.h>

#include "secure_partition_interface.h"

psa_status_t dp_secret_digest(uint32_t secret_index,
			void *p_digest,
			size_t digest_size)
{
	psa_status_t status;
	psa_invec in_vec[] = {
		{ .base = &secret_index, .len = sizeof(secret_index) },
	};

	psa_outvec out_vec[] = {
		{ .base = p_digest, .len = digest_size }
	};

	status = tfm_ns_interface_dispatch(
				(veneer_fn)tfm_dp_secret_digest_req_veneer,
				(uint32_t)in_vec,  IOVEC_LEN(in_vec),
				(uint32_t)out_vec, IOVEC_LEN(out_vec));

	return status;
}

int tfm_get_keystore_size(){
	uint32_t size;
	psa_status_t status;
	psa_invec out_vec[] = {
		{ .base = &size, .len = sizeof(size) },
	};

	status = tfm_ns_interface_dispatch(
				(veneer_fn)tfm_get_keystore_size_req_veneer,
				(uint32_t) NULL,  0,
				(uint32_t)out_vec, IOVEC_LEN(out_vec));

	return size;
}

int tfm_get_free_memory_size(){
	uint32_t size = tfm_ns_interface_dispatch(
				(veneer_fn)tfm_get_free_memory_size_req_veneer,
				(uint32_t) NULL, 0,
				(uint32_t) NULL, 0);

	return size;
}

int tfm_store_pk(char* public_key_hex){
	return 0;
}

int tfm_get_key(uint32_t index, char* public_key_hex){
	psa_status_t status;
	psa_invec in_vec[] = {
		{ .base = &index, .len = sizeof(index) },
	};

	psa_outvec out_vec[] = {
		{ .base = public_key_hex, .len = 96 }
	};

	status = tfm_ns_interface_dispatch(
				(veneer_fn)tfm_get_key_req_veneer,
				(uint32_t)in_vec,  IOVEC_LEN(in_vec),
				(uint32_t)out_vec, IOVEC_LEN(out_vec));

	return status;
}

int tfm_get_keys(char public_keys_hex_store_ns[10][96]){
	psa_status_t status;

	psa_outvec out_vec[] = {
		{ .base = public_keys_hex_store_ns, .len = sizeof(char)*1*96 },
	};

	status = tfm_ns_interface_dispatch(
				(veneer_fn)tfm_get_keys_req_veneer,
				(uint32_t) NULL, 0,
				(uint32_t)out_vec, IOVEC_LEN(out_vec));

	return status;
}

int tfm_secure_keygen(char* info, size_t infosize){
	uint32_t index;
	psa_status_t status;

    psa_invec in_vec[] = {
		{ .base = info, .len = infosize }
	};

	psa_outvec out_vec[] = {
		{ .base = &index, .len = sizeof(index) },
	};

	status = tfm_ns_interface_dispatch(
				(veneer_fn)tfm_secure_keygen_req_veneer,
				(uint32_t)in_vec, IOVEC_LEN(in_vec),
				(uint32_t)out_vec, IOVEC_LEN(out_vec));

	return index; //return status;
}

int tfm_sign_pk(char* pk, char* msg, char* sign){
	psa_status_t status;

    psa_invec in_vec[] = {
		{ .base = pk, .len = /*sizeof(pk)*/97 },
		{ .base = msg, .len = /*sizeof(msg)*/65 }/**/
	};

	psa_outvec out_vec[] = {
		{ .base = sign, .len = /*sizeof(sign)*/193 },
	};

	status = tfm_ns_interface_dispatch(
				(veneer_fn)tfm_sign_pk_req_veneer,
				(uint32_t)in_vec, IOVEC_LEN(in_vec),
				(uint32_t)out_vec, IOVEC_LEN(out_vec));

	printk("(tfm_sign_pk) pk: %s\n", pk);
	printk("(tfm_sign_pk) msg: %s\n", msg);
	printk("(tfm_sign_pk) sign: %s\n", sign);
	printk("(tfm_sign_pk) ret: %d\n", status);

	return status;
}

int tfm_verify_sign(char* pk, char* msg, char* sig){
	psa_status_t status;
	uint32_t ret;

	psa_invec in_vec[] = {
		{ .base = pk, .len = /*sizeof(pk)*/96 },
		{ .base = msg, .len = /*sizeof(msg)*/64 },
		{ .base = sig, .len = /*sizeof(msg)*/192 }
	};

	psa_outvec out_vec[] = {
		{ .base = &ret, .len = sizeof(ret) },
	};

	status = tfm_ns_interface_dispatch(
				(veneer_fn)tfm_verify_sign_req_veneer,
				(uint32_t)in_vec, IOVEC_LEN(in_vec),
				(uint32_t)out_vec, IOVEC_LEN(out_vec));

	return ret;
}

int tfm_reset(){
	psa_status_t status;

	status = tfm_ns_interface_dispatch(
				(veneer_fn)tfm_reset_req_veneer,
				(uint32_t) NULL, 0,
				(uint32_t) NULL, 0);

	return status;
}

int tfm_import_sk(char* sk){
	return 0;
}
```

## src/secure_partition_interface.h
```c
/*
 * Copyright (c) 2021 Nordic Semiconductor ASA.
 *
 * SPDX-License-Identifier: Apache-2.0
 */

#include "tfm_api.h"

psa_status_t dp_secret_digest(uint32_t secret_index,
			      void *p_digest,
			      size_t digest_size);
int tfm_get_keystore_size();
int tfm_store_pk(char* public_key_hex);
int tfm_get_key(uint32_t index, char* public_key_hex);
int tfm_get_keys(char public_keys_hex_store_ns[10][96]);
int tfm_secure_keygen(char* info, size_t infosize);
int tfm_sign_pk(char* pk, char* msg, char* sign);
int tfm_verify_sign(char* pk, char* msg, char* sig);
int tfm_reset();
int tfm_import_sk(char* sk);
```
